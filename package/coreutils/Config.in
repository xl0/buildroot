## package/coreutils/Config.in
```kconfig
config BR2_PACKAGE_COREUTILS
	bool "coreutils"
	depends on BR2_USE_WCHAR
	help
	  All of the basic file/text/shell utilities.  These are the
	  core utilities which are expected to exist on every system.
	  Busybox implements many of the most common.

	  Things like:
	  - chmod, cp, dd, dir, ls, etc...
	  - sort, tr, head, tail, wc, etc...
	  - whoami, who, etc...

	  http://www.gnu.org/software/coreutils/

config BR2_PACKAGE_COREUTILS_BINS
	depends on BR2_PACKAGE_COREUTILS
	string "Utils to install (None -> all)"
	default ""
	help
	  Only install selected binaries.

comment "coreutils requires a toolchain with WCHAR support"
	depends on !BR2_USE_WCHAR
```
